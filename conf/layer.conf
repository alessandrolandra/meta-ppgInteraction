## conf/layer.conf
```bitbake
# We have a conf and classes directory, add to BBPATH
BBPATH .= ":${LAYERDIR}"

# We have recipes-* directories, add to BBFILES
BBFILES += "${LAYERDIR}/recipes-*/*/*.bb \
            ${LAYERDIR}/recipes-*/*/*.bbappend"

BBFILE_COLLECTIONS += "meta-ppgInteraction"
BBFILE_PATTERN_meta-ppgInteraction = "^${LAYERDIR}/"
BBFILE_PRIORITY_meta-ppgInteraction = "6"

LAYERDEPENDS_meta-ppgInteraction = "core"
LAYERSERIES_COMPAT_meta-ppgInteraction = "dunfell"
```
